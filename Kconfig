## Kconfig
```kconfig
config ZMK_BEHAVIOR_REFCOUNT_KEY
    bool "Refcount Key behavior"
    default y
    help
      Wraps a key press so that multiple physical keys sharing the same keycode
      keep the key held until the last one is released.

menuconfig ZMK_BEHAVIOR_SENSOR_HOLD_ROTATE
    bool "Sensor hold rotate behavior"
    default y
    help
      Hold-style rotate behavior:
      - first step sends press
      - same direction steps only extend timeout
      - reverse direction releases previous and presses new
      - timeout releases
```

## dts/bindings/behaviours/zmk,behavior-refcount-key.yaml
```yaml
description: Refcount Key Behavior
compatible: "zmk,behavior-refcount-key"
include: one_param.yaml
```

## dts/bindings/behaviours/zmk,behavior-sensor-hold-rotate.yaml
```yaml
description: Sensor hold rotate behavior

compatible: "zmk,behavior-sensor-hold-rotate"

properties:
  "#sensor-binding-cells":
    type: int
    required: true
    const: 0
    description: "Number of argument cells for sensor-bindings."

  bindings:
    type: phandle-array
    required: true
    description: "Two bindings: CW then CCW (each can have params)."

  timeout-ms:
    type: int
    required: false
    default: 180
    description: "Release after this many ms without new steps."
```

## dts/bindings/behaviours/zmk,behavior-sensor-hold-step-rotate.yaml
```yaml
description: Sensor rotate behavior with hold + grouped step actions

compatible: "zmk,behavior-sensor-hold-step-rotate"

properties:
  "#sensor-binding-cells":
    type: int
    required: true
    const: 0

  timeout-ms:
    type: int
    required: false
    default: 180

  step-group-size:
    type: int
    required: false
    default: 5

  direction-hold-mode:
    type: int
    required: false
    default: 0

  bindings:
    type: phandle-array
    required: true
    description: "Four bindings: hold_cw, hold_ccw, step_cw, step_ccw"

  require-top-layer:
    type: boolean
    required: false
    description: "If set, behavior runs only on top layer."

  quick-release:
    type: boolean

  quick-release-allow-list:
    type: array
    required: false
```
